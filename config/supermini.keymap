/ {
    #define COPY  LC(C)   /* Command + C */
    #define PASTE LC(V)   /* Command + V */

    keymap {
        compatible = "zmk,keymap";

        default_layer {
            bindings = <
                &kp COPY
                &kp PASTE
            >;
        };
    };
};
