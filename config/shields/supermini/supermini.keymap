/ {
    keymap {
        compatible = "zmk,keymap";

        default_layer {
            bindings = <
                &kp LC(C)    // Command + C
                &kp LC(V)    // Command + V
            >;
        };
    };
};
