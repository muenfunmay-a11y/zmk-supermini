#include <behaviors.dtsi>
#include <dt-bindings/zmk/keys.h>

/ {
    keymap {
        compatible = "zmk,keymap";

        default_layer {
            bindings = <
                &kp LG(C)  // ปุ่ม 1: Command + C (ใช้ LGUI สำหรับ Mac)
                &kp LG(V)  // ปุ่ม 2: Command + V
            >;
        };
    };
};