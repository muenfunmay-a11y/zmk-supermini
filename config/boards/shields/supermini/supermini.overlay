// supermini.overlay

/ {
    chosen {
        zmk,kscan = &kscan0;
    };

    kscan0: kscan {
        compatible = "zmk,kscan-gpio-direct";
        label = "KSCAN";

        // input-gpios กำหนดขา GPIO ที่ใช้ในการอ่านค่า
        // <&gpio0 2 ...> คือ P0.02 (GPIO 2)
        // <&gpio0 29 ...> คือ P0.29 (GPIO 29)
        input-gpios
            = <&gpio0 2  (GPIO_ACTIVE_LOW | GPIO_PULL_UP)> // ปุ่ม 1 (P0.02)
            , <&gpio0 29 (GPIO_ACTIVE_LOW | GPIO_PULL_UP)> // ปุ่ม 2 (P0.29)
            ;
    };
};