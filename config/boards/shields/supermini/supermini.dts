/ {
    chosen {
        zmk,kscan = &kscan0;
    };

    kscan0: kscan {
        compatible = "zmk,kscan-gpio-matrix";

        rows = <1>;
        cols = <2>;

        row-gpios = <&gpio0 15 (GPIO_ACTIVE_LOW | GPIO_PULL_UP)>;

        col-gpios = <
            &gpio0 2  GPIO_ACTIVE_LOW
            &gpio0 29 GPIO_ACTIVE_LOW
        >;
    };
};
