#include <behaviors.dtsi>
#include <dt-bindings/zmk/keys.h>

/ {
    keymap {
        compatible = "zmk,keymap";

        // เลเยอร์เริ่มต้น (Layer 0)
        default_layer {
            // display-name = "SuperMini"; // (ไม่บังคับ)
            bindings = <
                &kp Q
                &kp W
            >;
        };
        
        // หากต้องการให้ Layer อื่นๆ เป็น &trans ทั้งหมด (ส่งผ่าน) สามารถทำได้
        // แต่สำหรับ 2 ปุ่มนี้ อาจไม่จำเป็นต้องมี Layer อื่นๆ
    };
};