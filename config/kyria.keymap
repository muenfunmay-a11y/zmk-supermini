/ {
    #define COPY  LC(C)
    #define PASTE LC(V)

    keymap {
        compatible = "zmk,keymap";

        default_layer {
            bindings = <
                &kp COPY
                &kp PASTE
            >;
        };
    };
};
